## drivers/Kconfig
```kconfig
# Copyright (c) 2026 Christoph Jans <jans.christoph@gmail.com>
# SPDX-License-Identifier: Apache-2.0

if I2C
rsource "i2c/Kconfig"
endif

if SERIAL
rsource "serial/Kconfig"
endif
```

## drivers/i2c/Kconfig
```kconfig
# Copyright (c) 2026 Christoph Jans <jans.christoph@gmail.com>
# SPDX-License-Identifier: Apache-2.0

config I2C_MM_NATIVE
	bool "Multi-master I2C port for native_sim"
	default y
	depends on DT_HAS_TWIXT_I2C_MM_NATIVE_ENABLED
	depends on ARCH_POSIX
	help
	  I2C controller and target of one native_sim process, on a bus shared
	  with other processes. See dts/bindings/i2c/twixt,i2c-mm-native.yaml.

config I2C_MM_GPIO
	bool "Multi-master I2C from a target-only block and GPIOs"
	default y
	depends on DT_HAS_TWIXT_I2C_MM_GPIO_ENABLED
	depends on GPIO
	select I2C_TARGET
	select TIMING_FUNCTIONS if I2C_MM_GPIO_PORT = "generic"
	imply DEVICE_DEINIT_SUPPORT
	help
	  Software controller with arbitration on the pins of a target-only
	  I2C block, such as the nRF TWIS. A target block that refuses to be
	  registered again after a transfer is initialized again
	  (DEVICE_DEINIT_SUPPORT). See
	  dts/bindings/i2c/twixt,i2c-mm-gpio.yaml.

config I2C_MM_GPIO_PORT
	string
	default "esp32" if I2C_MM_ESP32_TARGET
	default "rp2040" if SOC_SERIES_RP2040
	default "generic"
	depends on I2C_MM_GPIO
	help
	  The folder with this platform's i2c_mm_gpio_port.h: the pins and the
	  counter. generic uses the GPIO API and the timing functions; a platform
	  needs its own only where those are too slow for the bus.

config I2C_MM_GPIO_INIT_PRIORITY
	int "Init priority of the multi-master GPIO port"
	default 55
	depends on I2C_MM_GPIO
	help
	  After the target block (CONFIG_I2C_INIT_PRIORITY) and the GPIOs,
	  before twixt (CONFIG_TWIXT_INIT_PRIORITY).

config I2C_MM_TARGET_REREGISTER
	bool "The link registers the target again after every transfer"
	default y if DT_HAS_SNPS_DESIGNWARE_I2C_ENABLED && !I2C_MM_GPIO
	help
	  For drivers that leave target mode for a transfer and do not return to
	  it, such as the DesignWare driver alone. I2C_MM_GPIO restores its target
	  itself.

# A byte on the native_sim bus is 90 us; a coarser tick would round it up
configdefault SYS_CLOCK_TICKS_PER_SEC
	default 100000 if I2C_MM_NATIVE

config I2C_MM_ESP32_TARGET
	bool "Classic ESP32 target with GPIO clock stretching"
	default y
	depends on DT_HAS_TWIXT_ESP32_I2C_TARGET_ENABLED
	depends on SOC_ESP32 && GPIO && !SMP && !PM
	select I2C_TARGET
	help
	  Target backend for twixt,i2c-mm-gpio. Keeps the target peripheral alive
	  during software controller transfers. Classic ESP32, 100 kHz only.
	  Interrupts and callbacks run on the single enabled CPU. Flash writes
	  during target traffic are not supported.
```

## drivers/serial/Kconfig
```kconfig
# Copyright (c) 2026 Christoph Jans <jans.christoph@gmail.com>
# SPDX-License-Identifier: Apache-2.0

config UART_TWIXT
	bool "UART over twixt"
	default y
	depends on DT_HAS_TWIXT_UART_ENABLED
	depends on TWIXT
	select SERIAL_HAS_DRIVER
	select SERIAL_SUPPORT_INTERRUPT
	select UART_INTERRUPT_DRIVEN
	help
	  See dts/bindings/serial/twixt,uart.yaml.

if UART_TWIXT

config UART_TWIXT_RX_BUF_SIZE
	int "Receive buffer of each UART"
	default 256

config UART_TWIXT_TX_BUF_SIZE
	int "Transmit buffer of each UART"
	default 256

config UART_TWIXT_CHUNK
	int "Most bytes in one request"
	default 32
	range 1 252
	help
	  Longer chunks cost less overhead, shorter ones hold the bus for less
	  time. Up to TWIXT_REQ_DATA_MAX.

config UART_TWIXT_RETRY_MS
	int "Retry interval while the peer is full or the bus is taken, in ms"
	default 5

config UART_TWIXT_WORKQ_PRIORITY
	int "Priority of the UART work queue"
	default 2

config UART_TWIXT_WORKQ_STACK_SIZE
	int "Stack size of the UART work queue"
	default 1536

endif # UART_TWIXT

# Interrupt-driven, as MCUmgr's shell transport needs; Zephyr defaults to polling
# on native_sim
DT_CHOSEN_SHELL_UART := zephyr,shell-uart
DT_COMPAT_TWIXT_UART := twixt,uart

configdefault SHELL_BACKEND_SERIAL_INTERRUPT_DRIVEN
	default y if UART_TWIXT && $(dt_chosen_has_compat,$(DT_CHOSEN_SHELL_UART),$(DT_COMPAT_TWIXT_UART))
```

## dts/bindings/i2c/twixt,esp32-i2c-target.yaml
```yaml
# SPDX-License-Identifier: Apache-2.0

description: |
  Classic ESP32 I2C target with GPIO clock stretching for a repeated START.
  Used as the target backend of twixt,i2c-mm-gpio at 100 kHz. SDA and SCL
  must be on gpio0; the peripheral remains in target mode during controller
  transfers. The standard ESP32 I2C driver must not own this peripheral.

compatible: "twixt,esp32-i2c-target"
include: [i2c-controller.yaml, pinctrl-device.yaml]
properties:
  reg:
    required: true
  clocks:
    required: true
  interrupts:
    required: true
  scl-gpios:
    type: phandle-array
    required: true
  sda-gpios:
    type: phandle-array
    required: true
  port:
    type: int
    required: true
    enum: [0, 1]
```

## dts/bindings/i2c/twixt,i2c-mm-gpio.yaml
```yaml
# Copyright (c) 2026 Christoph Jans <jans.christoph@gmail.com>
# SPDX-License-Identifier: Apache-2.0

description: |
  Multi-master I2C from a target-only I2C block and two GPIOs on the same
  pins, for MCUs whose I2C controller cannot detect lost arbitration, such as
  the nRF TWIM (nRF52, nRF53, nRF54L, nRF91), or whose I2C block cannot be
  controller and target at once, such as the DesignWare one (Raspberry Pi
  Pico).

  The target block (target) serves requests. A transfer of this port
  unregisters it, which must hand the pins back to the GPIOs (the nRF TWIS
  does), clocks the transfer in software and registers the target again.
  Where configuring the GPIOs takes the pins away from the target block and
  its driver does not take them back on registering (Raspberry Pi Pico:
  DesignWare I2C), pinctrl-0 holds the target's pin function, applied before
  the target is registered again.

  - Every bit is read back: a 1 that reads 0 is lost arbitration (-EAGAIN).
  - The bus is free once SCL and SDA stayed high for bus-free-us; a bus
    that is not free within bus-timeout-us gives -EBUSY.
  - SDA low with SCL high for all of bus-timeout-us is a stuck bus: up to 9
    clocks and a STOP recover it before the START.
  - SCL stretching is waited for up to stretch-timeout-us.
  - During its own transfer the port NACKs its address: the other MCUs need
    CONFIG_TWIXT_LINK_NACK_RETRY_MS longer than its longest transfer, a request
    and a response of CONFIG_TWIXT_LINK_MSG_MAX bytes each.
  - By default it ends its STOP by registering the target again, so the target
    is back before the bus is free. A platform port may provide an optional
    handoff that keeps its target peripheral running (classic ESP32).
  - In target buffer mode it reports a STOP after a write to the target when
    SCL and SDA stay high for two bit times after the end of the write, in the
    target's interrupt: the target block must hold SCL low until it has the
    response to a read after a repeated START (the nRF TWIS does), and its
    driver need not report STOP itself.
  - The CPU clocks the bus; the high phase of each bit runs with interrupts
    locked, about half a bit time, and so does the last bus-free-us before
    each START.

    i2c-mm {
            compatible = "twixt,i2c-mm-gpio";
            target = <&i2c1>;
            scl-gpios = <&gpio0 27 0>;
            sda-gpios = <&gpio0 26 0>;
            clock-frequency = <I2C_BITRATE_STANDARD>;
            #address-cells = <1>;
            #size-cells = <0>;

            mcu_pico: pico@10 {
                    compatible = "twixt,mcu";
                    reg = <0x10>;
            };
    };

    &i2c1 {
            compatible = "nordic,nrf-twis";
            status = "okay";
            /* pinctrl with the same pins as scl-gpios and sda-gpios */
    };

compatible: "twixt,i2c-mm-gpio"

include: [i2c-controller.yaml, pinctrl-device.yaml]

properties:
  target:
    type: phandle
    required: true
    description: |
      Target-only I2C block on the same pins. In the default handoff,
      unregistering its target must release the pins. A platform port with
      a dedicated handoff may instead retain the target peripheral and
      temporarily route the pin outputs to GPIO.

  scl-gpios:
    type: phandle-array
    required: true
    description: SCL, driven open drain

  sda-gpios:
    type: phandle-array
    required: true
    description: SDA, driven open drain

  bus-free-us:
    type: int
    default: 30
    description: |
      How long SCL and SDA must stay high before this port starts. Longer
      than the 4.7 us the I2C specification asks after a STOP, and longer
      than any pause with both lines high inside a frame: up to 18 us were
      measured on a bus with a hardware controller, so a
      shorter time can start in the middle of another master's frame.

  bus-timeout-us:
    type: int
    default: 1000
    description: How long a transfer waits for a free bus before -EBUSY

  stretch-timeout-us:
    type: int
    default: 10000
    description: How long a target may hold SCL low before -ETIMEDOUT
```

## dts/bindings/i2c/twixt,native-i2c-mm.yaml
```yaml
# Copyright (c) 2026 Christoph Jans <jans.christoph@gmail.com>
# SPDX-License-Identifier: Apache-2.0

description: |
  Multi-master I2C port for native_sim: the I2C block of one MCU, controller
  and target. Every native_sim process is one MCU; processes with the same
  bus-id share one bus, in /dev/shm/twixt_i2c_mm_<bus-id>.

  - A controller that finds the bus busy waits for its STOP.
  - Controllers that START within start-window-us arbitrate on address byte
    and data; the lower wins, the others get -EAGAIN.
  - Target events raise irq-line, so the target callbacks run in an ISR; the
    controller waits for it, like SCL stretching.
  - A byte takes 9 bit times, so CONFIG_SYS_CLOCK_TICKS_PER_SEC defaults to
    100000; run in real time.
  - A stuck bus (i2c_mm_native_stick_bus()) is recovered before the next START.

  Test bench helpers: <drivers/i2c/i2c_mm_native.h>.

compatible: "twixt,native-i2c-mm"

include: i2c-controller.yaml

properties:
  bus-id:
    type: int
    default: 0
    description: Processes with the same bus-id share one virtual bus

  irq-line:
    type: int
    default: 8
    description: |
      native_sim interrupt line used to deliver target events to this port.
      Lines 0..2 are used by the simulator itself.

  irq-priority:
    type: int
    default: 1
    description: Priority of the target interrupt

  bus-timeout-us:
    type: int
    default: 50000
    description: |
      How long a controller waits for a busy bus to become free before it
      gives up with -EBUSY

  loopback:
    type: boolean
    description: |
      A controller of this port can address its own target, which most
      hardware cannot do. For tests that send raw transfers to their own
      target.

  start-window-us:
    type: int
    default: 500
    description: |
      Controllers that start within this time of each other are treated as
      starting at the same moment and arbitrate. A real bus needs a fraction
      of a bit time; separate processes cannot be that exact. Every transfer
      pays this time as START latency.
```

## dts/bindings/serial/twixt,uart.yaml
```yaml
# Copyright (c) 2026 Christoph Jans <jans.christoph@gmail.com>
# SPDX-License-Identifier: Apache-2.0

description: |
  A UART over twixt: a byte stream to one other MCU, peer. Point
  zephyr,shell-uart or zephyr,console at it, or bridge it with
  zephyr,uart-bridge.

    bus_uart: bus-uart {
            compatible = "twixt,uart";
            peer = <&gw>;
    };

compatible: "twixt,uart"

include: base.yaml

properties:
  peer:
    type: phandle
    required: true
    description: twixt,mcu at the other end
```

## dts/bindings/twixt/twixt,mcu.yaml
```yaml
# Copyright (c) 2026 Christoph Jans <jans.christoph@gmail.com>
# SPDX-License-Identifier: Apache-2.0

description: |
  An MCU on twixt, at its I2C address. /chosen twixt,self is the
  MCU the image runs on. See include/twixt/twixt.h.

    &i2c0 {
            mcu_a: mcu-a@10 {
                    compatible = "twixt,mcu";
                    reg = <0x10>;
            };
    };

    / {
            chosen {
                    twixt,self = &mcu_a;
            };
    };

compatible: "twixt,mcu"

include: i2c-device.yaml
```

## dts/bindings/twixt/twixt,smp-gateway-bt.yaml
```yaml
# Copyright (c) 2026 Christoph Jans <jans.christoph@gmail.com>
# SPDX-License-Identifier: Apache-2.0

description: |
  A Bluetooth device for one MCU's MCUmgr, for stock SMP tools: this MCU
  advertises one connectable device per node, each with its own identity and
  the standard SMP service, and what comes in on a connection goes to the
  MCUmgr service of its peer. One node per MCU to reach, this MCU included.

    gateway-bt-pico {
            compatible = "twixt,smp-gateway-bt";
            peer = <&mcu_pico>;
    };

compatible: "twixt,smp-gateway-bt"

include: base.yaml

properties:
  peer:
    type: phandle
    required: true
    description: twixt,mcu to reach

  bt-name:
    type: string
    description: |
      Name it advertises, 28 bytes at most. By default the node name of peer,
      without its unit address: pico for pico@10.
```

## dts/bindings/twixt/twixt,smp-gateway-serial.yaml
```yaml
# Copyright (c) 2026 Christoph Jans <jans.christoph@gmail.com>
# SPDX-License-Identifier: Apache-2.0

description: |
  A port to one MCU's MCUmgr, for stock SMP tools: the SMP packets on the port
  go to the MCUmgr service of peer, and its responses come back. One node per
  MCU to reach, this MCU included. One request at a time over all ports.

    usb_nrf: usb-nrf {
            compatible = "zephyr,cdc-acm-uart";
            hw-flow-control;
    };

    gateway-nrf {
            compatible = "twixt,smp-gateway-serial";
            serial = <&usb_nrf>;
            peer = <&mcu_nrf>;
    };

compatible: "twixt,smp-gateway-serial"

include: base.yaml

properties:
  serial:
    type: phandle
    required: true
    description: |
      UART to the host, with serial SMP on it. A CDC-ACM port needs
      hw-flow-control, or a response too large for its buffer loses bytes.

  peer:
    type: phandle
    required: true
    description: twixt,mcu to reach
```

## samples/hello/sample.yaml
```yaml
# Copyright (c) 2026 Christoph Jans <jans.christoph@gmail.com>
# SPDX-License-Identifier: Apache-2.0

sample:
  name: Hello over twixt
common:
  platform_allow:
    - native_sim
  integration_platforms:
    - native_sim
  tags:
    - i2c
tests:
  # MCU a, started by twister; pytest/test_hello.py starts b next to it
  sample.twixt.hello:
    extra_args: MCU=a
    harness: pytest
    required_applications:
      - name: sample.twixt.hello.mcu_b
  sample.twixt.hello.mcu_b:
    extra_args: MCU=b
    build_only: true
```
