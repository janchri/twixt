## subsys/twixt/Kconfig
```kconfig
# Copyright (c) 2026 Christoph Jans <jans.christoph@gmail.com>
# SPDX-License-Identifier: Apache-2.0

menuconfig TWIXT_LINK
	bool "Multi-master I2C link: one request/response transfer each"
	select I2C_TARGET
	help
	  See <twixt/link.h>.

if TWIXT_LINK

config TWIXT_LINK_MSG_MAX
	int "Longest request or response"
	default 64
	range 8 255
	help
	  In bytes. The same on every MCU of the bus.

config TWIXT_LINK_RETRY_MS
	int "Retry time after lost arbitration or a busy bus, in ms"
	default 500

config TWIXT_LINK_NACK_RETRY_MS
	int "Retry time after an address NACK, in ms"
	default 5
	help
	  An MCU sending itself may NACK its address until it is a target again.
	  After this long the target counts as absent (-ENXIO). Other NACKs are
	  not retried: the request may have run.

module = TWIXT_LINK
module-str = twixt_link
source "subsys/logging/Kconfig.template.log_config"

endif # TWIXT_LINK

DT_CHOSEN_TWIXT_SELF := twixt,self

menuconfig TWIXT
	bool "twixt: services between equal MCUs on a multi-master I2C bus"
	default y if $(dt_chosen_enabled,$(DT_CHOSEN_TWIXT_SELF))
	depends on I2C
	select TWIXT_LINK
	help
	  On with /chosen twixt,self. See <twixt/twixt.h>.

if TWIXT

config TWIXT_INIT_PRIORITY
	int "Init priority"
	default 60
	help
	  After the I2C driver.

config TWIXT_SHELL
	bool "Shell commands"
	default y
	depends on SHELL

rsource "service/Kconfig.ping"
rsource "service/Kconfig.echo"
rsource "service/Kconfig.settings"
rsource "service/Kconfig.smp"
rsource "client/Kconfig.stress"
rsource "client/Kconfig.smp_gateway"

module = TWIXT
module-str = twixt
source "subsys/logging/Kconfig.template.log_config"

endif # TWIXT
```

## subsys/twixt/Kconfig.settings
```kconfig
# Copyright (c) 2026 Christoph Jans <jans.christoph@gmail.com>
# SPDX-License-Identifier: Apache-2.0

menuconfig TWIXT_SETTINGS
	bool "Settings service"
	depends on SETTINGS
	select SETTINGS_RUNTIME
	help
	  See <twixt/settings.h>.

if TWIXT_SETTINGS

config TWIXT_SETTINGS_KEY_MAX
	int "Longest key, NUL included"
	default 24
	range 2 128

config TWIXT_SETTINGS_VALUE_MAX
	int "Longest value"
	default 16
	range 1 251
	help
	  Op, key and value of a set must fit TWIXT_REQ_DATA_MAX.

endif # TWIXT_SETTINGS
```

## subsys/twixt/client/Kconfig.smp_gateway
```kconfig
# Copyright (c) 2026 Christoph Jans <jans.christoph@gmail.com>
# SPDX-License-Identifier: Apache-2.0

menuconfig TWIXT_SMP_GATEWAY
	bool "MCUmgr of the MCUs for stock SMP tools"
	default y
	depends on TWIXT_SMP
	depends on DT_HAS_TWIXT_SMP_GATEWAY_SERIAL_ENABLED || DT_HAS_TWIXT_SMP_GATEWAY_BT_ENABLED
	help
	  Stock SMP tools update any MCU of the bus through this one, on a port
	  or a Bluetooth device per MCU: twixt,smp-gateway-serial and
	  twixt,smp-gateway-bt. It takes the responses: twixt_smp_rsp_get() is
	  not for the application then.

if TWIXT_SMP_GATEWAY

config TWIXT_SMP_GATEWAY_RSP_TIMEOUT_MS
	int "Wait for a response, in ms"
	default 60000
	help
	  The first write of an image erases a slot, which takes a while. All
	  ports wait meanwhile.

config TWIXT_SMP_GATEWAY_STACK_SIZE
	int "Stack of the gateway's thread"
	default 2048

config TWIXT_SMP_GATEWAY_PRIORITY
	int "Priority of the gateway's thread"
	default 5

config TWIXT_SMP_GATEWAY_SERIAL
	def_bool DT_HAS_TWIXT_SMP_GATEWAY_SERIAL_ENABLED
	depends on SERIAL
	select UART_INTERRUPT_DRIVEN
	select UART_LINE_CTRL
	select BASE64
	select CRC
	select MCUMGR_TRANSPORT_SERIAL_HAS_SMP_OVER_CONSOLE

config TWIXT_SMP_GATEWAY_RX_BUF_SIZE
	int "Bytes from the host waiting, per port"
	default 256
	depends on TWIXT_SMP_GATEWAY_SERIAL

config TWIXT_SMP_GATEWAY_LINE_MAX
	int "Longest line of serial SMP, per port"
	default 512
	depends on TWIXT_SMP_GATEWAY_SERIAL

config TWIXT_SMP_GATEWAY_BT
	def_bool DT_HAS_TWIXT_SMP_GATEWAY_BT_ENABLED
	depends on BT_PERIPHERAL && BT_EXT_ADV

config TWIXT_SMP_GATEWAY_BT_IDLE_MS
	int "Drop a Bluetooth connection without SMP traffic after, in ms"
	default 60000
	depends on TWIXT_SMP_GATEWAY_BT
	help
	  A device does not advertise while connected, and a tool that died can
	  leave the link up. A request waiting for its response does not count
	  as quiet.

endif # TWIXT_SMP_GATEWAY
```

## subsys/twixt/client/Kconfig.stress
```kconfig
# Copyright (c) 2026 Christoph Jans <jans.christoph@gmail.com>
# SPDX-License-Identifier: Apache-2.0

menuconfig TWIXT_STRESS
	bool "Echo load"
	depends on TWIXT_ECHO
	help
	  A thread sends echo requests round-robin, with every length up to the
	  limit, and checks every answer byte. See <twixt/client/stress.h>. With
	  CONFIG_TWIXT_SHELL also "twixt stress".

if TWIXT_STRESS

config TWIXT_STRESS_STACK_SIZE
	int "Stack of the load thread"
	default 1024

endif # TWIXT_STRESS
```

## subsys/twixt/service/Kconfig.echo
```kconfig
# Copyright (c) 2026 Christoph Jans <jans.christoph@gmail.com>
# SPDX-License-Identifier: Apache-2.0

config TWIXT_ECHO
	bool "Echo service"
	default y
	help
	  Answers with the request data, for tests of the bus. See
	  <twixt/service/echo.h>.
```

## subsys/twixt/service/Kconfig.ping
```kconfig
# Copyright (c) 2026 Christoph Jans <jans.christoph@gmail.com>
# SPDX-License-Identifier: Apache-2.0

config TWIXT_PING
	bool "Ping service"
	default y
	help
	  Every MCU should answer it. See <twixt/service/ping.h>.
```
