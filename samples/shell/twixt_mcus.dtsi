/*
 * Copyright (c) 2026 Christoph Jans <jans.christoph@gmail.com>
 *
 * SPDX-License-Identifier: Apache-2.0
 */

/* The MCUs on the bus, the same for every image: included in the I2C bus node
 * of each board's overlay (boards/). The bridge has the highest address: when
 * it and a board start at the same moment, the board's request wins.
 */

mcu_nrf2: nrf2@10 {
	compatible = "twixt,mcu";
	reg = <0x10>;
};

mcu_nrf: nrf@11 {
	compatible = "twixt,mcu";
	reg = <0x11>;
};

mcu_nrf3: nrf3@12 {
	compatible = "twixt,mcu";
	reg = <0x12>;
};

mcu_pico: pico@70 {
	compatible = "twixt,mcu";
	reg = <0x70>;
};
