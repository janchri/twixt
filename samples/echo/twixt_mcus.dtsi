/*
 * Copyright (c) 2026 Christoph Jans <jans.christoph@gmail.com>
 *
 * SPDX-License-Identifier: Apache-2.0
 */

/* The MCUs on the bus, the same for every image: included in the bus node of each board's
 * overlay (boards/)
 */

mcu_a: mcu-a@10 {
	compatible = "twixt,mcu";
	reg = <0x10>;
};

mcu_b: mcu-b@11 {
	compatible = "twixt,mcu";
	reg = <0x11>;
};
