/*
 * Copyright (c) 2026 Christoph Jans <jans.christoph@gmail.com>
 *
 * SPDX-License-Identifier: Apache-2.0
 */

/* A board: shell on a UART to the gateway */

/ {
	chosen {
		zephyr,shell-uart = &bus_uart;
	};

	bus_uart: bus-uart {
		compatible = "twixt,uart";
		peer = <&mcu_gw>;
	};
};
