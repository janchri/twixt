## CMakeLists.txt
```
# Copyright (c) 2026 Christoph Jans <jans.christoph@gmail.com>
# SPDX-License-Identifier: Apache-2.0

cmake_minimum_required(VERSION 3.20.0)

# One image per MCU: MCU picks which MCU of boards/native_sim.overlay this image is
# Under sysbuild (the Raspberry Pi Pico), -DMCU is in the sysbuild cache, not in this image's
if(SYSBUILD_CACHE)
  file(STRINGS ${SYSBUILD_CACHE} sysbuild_mcu REGEX "^MCU:")
  if(sysbuild_mcu)
    string(REGEX REPLACE "^MCU:[A-Z]*=" "" sysbuild_mcu "${sysbuild_mcu}")
    set(MCU ${sysbuild_mcu} CACHE STRING "" FORCE)
  endif()
endif()
set(MCU a CACHE STRING "MCU to build: a or b")
list(APPEND DTS_EXTRA_CPPFLAGS -DTWIXT_SELF_LABEL=mcu_${MCU})

find_package(Zephyr REQUIRED HINTS $ENV{ZEPHYR_BASE})
project(twixt_smp)

target_sources(app PRIVATE src/main.c)
target_sources_ifdef(CONFIG_USB_DEVICE_STACK_NEXT app PRIVATE src/usb.c)
```

## sample.yaml
```
# Copyright (c) 2026 Christoph Jans <jans.christoph@gmail.com>
# SPDX-License-Identifier: Apache-2.0

sample:
  name: MCUmgr over twixt
common:
  tags:
    - i2c
    - mcumgr
tests:
  # MCU a, started by twister; pytest/test_smp.py starts b next to it
  sample.twixt.smp:
    platform_allow: native_sim
    integration_platforms:
      - native_sim
    extra_args: MCU=a
    harness: pytest
    required_applications:
      - name: sample.twixt.smp.mcu_b
  sample.twixt.smp.mcu_b:
    platform_allow: native_sim
    extra_args: MCU=b
    build_only: true
  # On real boards (README): b on an nRF7002 DK, the DUT, and a on a Raspberry
  # Pico; with --device-testing, twister flashes both and pytest/test_smp.py
  # reads both logs
  sample.twixt.smp.nrf7002dk:
    platform_allow: nrf7002dk/nrf5340/cpuapp
    integration_platforms:
      - nrf7002dk/nrf5340/cpuapp
    extra_args: MCU=b
    harness: pytest
    harness_config:
      required_devices:
        - platform: rpi_pico/rp2040/mcuboot
          application: sample.twixt.smp.rpi_pico
  # a on the Pico: the image alone, signed for the MCUboot that is on the Pico
  # (README), so that the smp runner can send it over MCUmgr
  sample.twixt.smp.rpi_pico:
    platform_allow: rpi_pico/rp2040/mcuboot
    integration_platforms:
      - rpi_pico/rp2040/mcuboot
    extra_args: MCU=a
    extra_configs:
      - CONFIG_BOOTLOADER_MCUBOOT=y
      - CONFIG_MCUBOOT_BOOTLOADER_MODE_SWAP_USING_OFFSET=y
      - CONFIG_MCUBOOT_SIGNATURE_KEY_FILE="bootloader/mcuboot/root-rsa-2048.pem"
    build_only: true
```

## prj.conf
```kconfig
# Copyright (c) 2026 Christoph Jans <jans.christoph@gmail.com>
# SPDX-License-Identifier: Apache-2.0

# CONFIG_TWIXT and the bus port come with the devicetree
CONFIG_I2C=y
CONFIG_LOG=y
CONFIG_LOG_BACKEND_SHOW_COLOR=n

# MCUmgr on the twixt MCUmgr service, os group: echo
CONFIG_MCUMGR=y
CONFIG_NET_BUF=y
CONFIG_ZCBOR=y
CONFIG_MCUMGR_GRP_OS=y
CONFIG_TWIXT_SMP=y
```

## board.conf
```kconfig
# Copyright (c) 2026 Christoph Jans <jans.christoph@gmail.com>
# SPDX-License-Identifier: Apache-2.0

# Shell on the bus UART; the log stays on stdout, off the bus
CONFIG_SHELL=y
CONFIG_SHELL_LOG_BACKEND=n
CONFIG_SHELL_VT100_COLORS=n

# MCUmgr on the shell, os group: echo and the parameters clients ask for
CONFIG_MCUMGR=y
CONFIG_NET_BUF=y
CONFIG_ZCBOR=y
CONFIG_CRC=y
CONFIG_BASE64=y
CONFIG_MCUMGR_TRANSPORT_SHELL=y
CONFIG_MCUMGR_GRP_OS=y
CONFIG_MCUMGR_GRP_OS_MCUMGR_PARAMS=y
```

## boards/nrf7002dk_nrf5340_cpuapp.conf
```kconfig
# Copyright (c) 2026 Christoph Jans <jans.christoph@gmail.com>
# SPDX-License-Identifier: Apache-2.0

# The TWIS driver hands over whole messages
CONFIG_I2C_TARGET_BUFFER_MODE=y
CONFIG_I2C_NRFX_TWIS_BUF_SIZE=64

# The software controllers on the bus NACK their address during their own transfers, up to a
# request and a response of 64 bytes at 100 kHz
CONFIG_I2C_MM_NACK_RETRY_MS=20
```

## boards/rpi_pico_rp2040_mcuboot.conf
```kconfig
# Copyright (c) 2026 Christoph Jans <jans.christoph@gmail.com>
# SPDX-License-Identifier: Apache-2.0

# The USB device "twixt pico", brought up before main() (src/usb.c): the log on one CDC-ACM port,
# MCUmgr on another; the CDC-ACM driver must not log to itself
CONFIG_USB_DEVICE_STACK_NEXT=y
CONFIG_USBD_CDC_ACM_CLASS=y
CONFIG_CDC_ACM_SERIAL_INITIALIZE_AT_BOOT=n
CONFIG_USBD_CDC_ACM_LOG_LEVEL_OFF=y

# The log through the shell on the log port: the shell writes interrupt-driven and waits for the
# host instead of losing lines, which the console's poll_out does without hw-flow-control
CONFIG_SHELL=y
CONFIG_SHELL_LOG_BACKEND=y
CONFIG_SHELL_VT100_COMMANDS=n
CONFIG_SHELL_PROMPT_UART=""
CONFIG_LOG_BACKEND_UART=n

# The DesignWare block stays the target: twixt,i2c-mm-gpio hands it its pins
CONFIG_I2C_MM_TARGET_REREGISTER=n

# The software controllers on the bus NACK their address during their own transfers, up to a
# request and a response of 64 bytes at 100 kHz
CONFIG_I2C_MM_NACK_RETRY_MS=20

# MCUmgr, to update the image over its USB port under MCUboot (smpmgr ... upgrade): img and os
# (reset, parameters)
CONFIG_MCUMGR=y
CONFIG_NET_BUF=y
CONFIG_ZCBOR=y
CONFIG_CRC=y
CONFIG_BASE64=y
CONFIG_FLASH=y
CONFIG_FLASH_MAP=y
CONFIG_STREAM_FLASH=y
CONFIG_IMG_MANAGER=y
CONFIG_IMG_ERASE_PROGRESSIVELY=y
CONFIG_MCUMGR_GRP_IMG=y
CONFIG_MCUMGR_GRP_OS=y
CONFIG_MCUMGR_GRP_OS_MCUMGR_PARAMS=y
CONFIG_REBOOT=y
CONFIG_SYSTEM_WORKQUEUE_STACK_SIZE=2048
CONFIG_UART_MCUMGR=y
CONFIG_MCUMGR_TRANSPORT_UART=y
```

## board.overlay
```dts
/*
 * Copyright (c) 2026 Christoph Jans <jans.christoph@gmail.com>
 *
 * SPDX-License-Identifier: Apache-2.0
 */

/* The board: shell, and so MCUmgr, on a UART to the gateway */

/ {
	chosen {
		zephyr,shell-uart = &bus_uart;
	};

	bus_uart: bus-uart {
		compatible = "twixt,uart";
		peer = <&mcu_gw>;
	};
};
```

## gateway.overlay
```dts
/*
 * Copyright (c) 2026 Christoph Jans <jans.christoph@gmail.com>
 *
 * SPDX-License-Identifier: Apache-2.0
 */

/* The gateway: a UART to the board, bridged to a PTY */

/ {
	bus_uart_a: bus-uart-a {
		compatible = "twixt,uart";
		peer = <&mcu_a>;
	};

	bridge-a {
		compatible = "zephyr,uart-bridge";
		peers = <&bus_uart_a &host_a>;
	};
};

&host_a {
	status = "okay";
};
```

## boards/native_sim.overlay
```dts
/*
 * Copyright (c) 2026 Christoph Jans <jans.christoph@gmail.com>
 *
 * SPDX-License-Identifier: Apache-2.0
 */

/* The bus on native_sim (twixt,native-i2c-mm); TWIXT_SELF_LABEL is mcu_<MCU> */

/ {
	chosen {
		twixt,self = &TWIXT_SELF_LABEL;
	};
};

&i2c0 {
	compatible = "twixt,native-i2c-mm";
	bus-id = <3>;

#include "../twixt_mcus.dtsi"
};
```

## src/main.c
```c
/*
 * Copyright (c) 2026 Christoph Jans <jans.christoph@gmail.com>
 *
 * SPDX-License-Identifier: Apache-2.0
 *
 * MCUmgr over twixt (TWIXT_SERVICE_SMP): two MCUs with MCUmgr on the twixt
 * MCUmgr service. b sends a an os echo request, and a's MCUmgr answers.
 */

#include <string.h>
#include <zephyr/kernel.h>
#include <zephyr/logging/log.h>
#include <zephyr/mgmt/mcumgr/smp/smp.h>
#include <zephyr/sys/byteorder.h>

#include <twixt/twixt.h>
#include <twixt/ping.h>
#include <twixt/smp.h>

LOG_MODULE_REGISTER(smp_sample, LOG_LEVEL_INF);

#define SERVER  DT_REG_ADDR(DT_NODELABEL(mcu_a))
#define TEXT    "hello over the bus"
#define HDR_LEN 8

BUILD_ASSERT(sizeof(TEXT) - 1 < 24, "a short CBOR text");

/* os echo {"d": TEXT}: SMP v2, write, group 0, command 0 */
static size_t echo_request(uint8_t *pkt)
{
	static const uint8_t cbor[] = {0xa1, 0x61, 'd', 0x60 + sizeof(TEXT) - 1};
	size_t len = sizeof(cbor) + sizeof(TEXT) - 1;

	memset(pkt, 0, HDR_LEN);
	pkt[0] = (1 << 3) | 2;
	sys_put_be16(len, &pkt[2]);
	memcpy(&pkt[HDR_LEN], cbor, sizeof(cbor));
	memcpy(&pkt[HDR_LEN + sizeof(cbor)], TEXT, sizeof(TEXT) - 1);
	return HDR_LEN + len;
}

/* MCUmgr encodes the response map with indefinite length: the text is inside */
static bool contains(const struct net_buf *nb, const char *text)
{
	for (size_t i = HDR_LEN; i + strlen(text) <= nb->len; i++) {
		if (memcmp(&nb->data[i], text, strlen(text)) == 0) {
			return true;
		}
	}
	return false;
}

int main(void)
{
	uint8_t pkt[HDR_LEN + 4 + sizeof(TEXT)];
	struct twixt_ping_info info;
	struct net_buf *nb;
	uint8_t src;
	int ret;

	LOG_INF("%s at 0x%02x: MCUmgr on the twixt service", twixt_self_name(), twixt_self_addr());
	if (twixt_self_addr() == SERVER) {
		return 0;
	}

	/* Again and again, for a terminal opened later; the server may still boot */
	for (;; k_sleep(K_SECONDS(2))) {
		ret = twixt_ping_wait(SERVER, &info, K_SECONDS(5));
		if (ret == 0) {
			ret = twixt_smp_send(SERVER, pkt, echo_request(pkt));
		}
		if (ret) {
			LOG_ERR("MCUmgr echo: %d", ret);
			continue;
		}
		nb = twixt_smp_rsp_get(&src, K_SECONDS(5));
		if (nb == NULL || src != SERVER || !contains(nb, TEXT)) {
			LOG_ERR("MCUmgr echo: no answer");
		} else {
			LOG_INF("MCUmgr echo from 0x%02x: %s", src, TEXT);
		}
		if (nb != NULL) {
			smp_packet_free(nb);
		}
	}
	return 0;
}
```
