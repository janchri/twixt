/*
 * Copyright (c) 2026 Christoph Jans <jans.christoph@gmail.com>
 *
 * SPDX-License-Identifier: Apache-2.0
 */

mcu_pico: pico@10 {
	compatible = "twixt,mcu";
	reg = <0x10>;
};

mcu_nrf: nrf@11 {
	compatible = "twixt,mcu";
	reg = <0x11>;
};
