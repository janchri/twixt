## subsys/twixt/service/Kconfig.smp
```kconfig
# Copyright (c) 2026 Christoph Jans <jans.christoph@gmail.com>
# SPDX-License-Identifier: Apache-2.0

menuconfig TWIXT_SMP
	bool "MCUmgr service"
	depends on MCUMGR
	select CRC if TWIXT_SMP_CRC
	help
	  This MCU's MCUmgr answers SMP requests from the others, and
	  twixt_smp_send() sends packets to them. See <twixt/service/smp.h>.

if TWIXT_SMP

config TWIXT_SMP_CRC
	bool "CRC-16 over each packet"
	default y
	help
	  The same on every MCU of the bus. A packet with a wrong CRC is
	  dropped; the sender of a request then times out.

config TWIXT_SMP_PEERS
	int "Packets coming in at the same time"
	default 4
	help
	  One per MCU sending to this one at once. Each holds one buffer of
	  CONFIG_MCUMGR_TRANSPORT_NETBUF_COUNT while it comes in; a sender
	  finding the pool empty gets -ENOMEM and may try again.

config TWIXT_SMP_TIMEOUT_MS
	int "Silence that drops an incomplete packet, in ms"
	default 5000
	range 1 3600000
	help
	  Between one and two times this long after its last fragment. Longer
	  than a sender may pause between fragments, including
	  CONFIG_TWIXT_LINK_RETRY_MS on a busy bus.

config TWIXT_SMP_RSP_MAX
	int "Responses waiting for twixt_smp_rsp_get()"
	default 2
	range 1 255
	help
	  Each holds one MCUmgr buffer; further responses are dropped and
	  counted. Less than CONFIG_MCUMGR_TRANSPORT_NETBUF_COUNT.

endif # TWIXT_SMP
```

## tests/api/testcase.yaml
```yaml
# Copyright (c) 2026 Christoph Jans <jans.christoph@gmail.com>
# SPDX-License-Identifier: Apache-2.0

tests:
  twixt.one_mcu:
    platform_allow:
      - native_sim
    integration_platforms:
      - native_sim
    tags:
      - i2c
      - settings
```

## tests/link/testcase.yaml
```yaml
# Copyright (c) 2026 Christoph Jans <jans.christoph@gmail.com>
# SPDX-License-Identifier: Apache-2.0

tests:
  twixt.link:
    platform_allow:
      - native_sim
    integration_platforms:
      - native_sim
    tags:
      - i2c
```

## tests/smp_update/testcase.yaml
```yaml
# Copyright (c) 2026 Christoph Jans <jans.christoph@gmail.com>
# SPDX-License-Identifier: Apache-2.0

common:
  tags:
    - i2c
    - mcumgr
tests:
  # With --device-testing: nrf on the DK, the DUT, is updated through the USB port of pico on the
  # Pico, back and forth to a second build of itself. Without it, only built
  twixt.smp_update.nrf7002dk:
    sysbuild: true
    platform_allow: nrf7002dk/nrf5340/cpuapp
    integration_platforms:
      - nrf7002dk/nrf5340/cpuapp
    extra_args:
      - MCU=nrf
      - VERSION=1
    harness: pytest
    harness_config:
      required_devices:
        - platform: rpi_pico/rp2040/mcuboot
          application: twixt.smp_update.rpi_pico
    required_applications:
      - name: twixt.smp_update.nrf7002dk.v2
    timeout: 900
  twixt.smp_update.nrf7002dk.v2:
    sysbuild: true
    build_only: true
    platform_allow: nrf7002dk/nrf5340/cpuapp
    extra_args:
      - MCU=nrf
      - VERSION=2
  twixt.smp_update.rpi_pico:
    build_only: true
    platform_allow: rpi_pico/rp2040/mcuboot
    integration_platforms:
      - rpi_pico/rp2040/mcuboot
    extra_args: MCU=pico
    extra_configs:
      - CONFIG_BOOTLOADER_MCUBOOT=y
      - CONFIG_MCUBOOT_BOOTLOADER_MODE_SWAP_USING_OFFSET=y
      - CONFIG_MCUBOOT_SIGNATURE_KEY_FILE="bootloader/mcuboot/root-rsa-2048.pem"
  # Bluetooth stays by hand (README.rst)
  twixt.smp_update.ble.nrf7002dk:
    sysbuild: true
    build_only: true
    platform_allow: nrf7002dk/nrf5340/cpuapp
    extra_args:
      - MCU=nrf
      - ROUTE=ble
      - SB_CONFIG_NET_CORE_IMAGE_HCI_IPC=y
```
